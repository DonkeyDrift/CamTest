## tab5/sdkconfig.defaults
```kconfig
# CamTest Tab5 — ESP32-P4(主控) + ESP32-C6(Wi-Fi 协处理器)
# 目标锁定（防呆）：显式声明目标芯片
CONFIG_IDF_TARGET="esp32p4"

# ---- Flash / 分区（Tab5 16MB）----
CONFIG_ESPTOOLPY_FLASHSIZE_16MB=y
CONFIG_ESPTOOLPY_FLASHSIZE="16MB"
CONFIG_PARTITION_TABLE_CUSTOM=y
CONFIG_PARTITION_TABLE_CUSTOM_FILENAME="partitions.csv"

# ---- PSRAM（Tab5 32MB Octal，200MHz；帧缓冲必须落 PSRAM）----
CONFIG_SPIRAM=y
CONFIG_SPIRAM_SPEED_200M=y
CONFIG_IDF_EXPERIMENTAL_FEATURES=y
CONFIG_SPIRAM_USE_MALLOC=y
CONFIG_SPIRAM_MALLOC_ALWAYSINTERNAL=16384
CONFIG_SPIRAM_MALLOC_RESERVE_INTERNAL=32768
CONFIG_SPIRAM_TRY_ALLOCATE_WIFI_LWIP=y

# ---- 芯片版本（Tab5 出货 P4 <3.0，官方 BSP 示例同款）----
CONFIG_ESP32P4_SELECTS_REV_LESS_V3=y

# ---- 调度 ----
CONFIG_FREERTOS_HZ=1000
CONFIG_ESP_MAIN_TASK_STACK_SIZE=8192

# ---- CPU 占用率统计 ----
CONFIG_FREERTOS_USE_TRACE_FACILITY=y
CONFIG_FREERTOS_USE_STATS_FORMATTING_FUNCTIONS=y
CONFIG_FREERTOS_GENERATE_RUN_TIME_STATS=y

# ---- USB UVC（usb_host_uvc，热插拔；坑位继承自 S31 工程）----
# 控制传输缓冲：默认 256 字节装不下 UVC 配置描述符（真机坑 #1）
CONFIG_USB_HOST_CONTROL_TRANSFER_MAX_SIZE=1024
# 每档离散帧间隔数组长度（部分摄像头列多档帧率，默认 3 不够）
CONFIG_UVC_INTERVAL_ARRAY_SIZE=6
CONFIG_UVC_PRINTF_CONFIGURATION_DESCRIPTOR=y

# ---- Wi-Fi：C6 协处理器（esp_hosted SDIO，Tab5 板级引脚默认值）----
CONFIG_ESP_HOSTED=y
CONFIG_ESP32P4_TAB5_C6_BOARD=y

# ---- HTTP 服务器 ----
CONFIG_HTTPD_MAX_REQ_HDR_LEN=1024
CONFIG_HTTPD_MAX_URI_LEN=1024
CONFIG_HTTPD_MAX_URI_HANDLERS=16

# ---- 并发 socket + TCP 窗口（S31 实测：49KB 窗口下 640@60 到达 45fps）----
CONFIG_LWIP_MAX_SOCKETS=24
CONFIG_LWIP_TCP_SND_BUF_DEFAULT=49152
CONFIG_LWIP_TCP_WND_DEFAULT=49152

# ---- 看门狗：长发送/编码阻塞较久，放宽任务级 WDT 到 10 s ----
CONFIG_ESP_TASK_WDT_INIT=y
CONFIG_ESP_TASK_WDT_TIMEOUT_S=10

# ---- mDNS ----
CONFIG_MDNS_RESERVE_SEARCH_DOMAIN=n
```
